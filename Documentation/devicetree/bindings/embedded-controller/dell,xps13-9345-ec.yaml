## Documentation/devicetree/bindings/embedded-controller/dell,xps13-9345-ec.yaml
```yaml
# SPDX-License-Identifier: (GPL-2.0-only OR BSD-2-Clause)
%YAML 1.2
---
$id: http://devicetree.org/schemas/embedded-controller/dell,xps-9345-ec.yaml#
$schema: http://devicetree.org/meta-schemas/core.yaml#

title: Dell XPS 9345 Embedded Controller

maintainers:
  - Aleksandrs Vinarskis <alex@vinarskis.com>

description:
  The Dell XPS 9345 has an Embedded Controller (EC) which handles thermal and power
  management. It is communicating with SoC over multiple i2c busses. Particular driver
  is for EC subsystem that handles fan speed control, thermal shutdown, peripherals
  supply including trackpad, mouse, display.

properties:
  compatible:
    const: dell,xps13-9345-ec

  reg:
    const: 0x3b

  interrupts:
    maxItems: 1

  io-channels:
    description:
      ADC channels connected to the 7 onboard thermistors on PMC8380C (SID 1).
      EC requires frequent thermal readings of these channels to perform
      automated fan speed control.
    items:
      - description: sys_therm0, AMUX3_GPIO, around DRAM
      - description: sys_therm1, AMUX4_GPIO, around lhs Type-C charging controller
      - description: sys_therm2, AMUX_THM1, around upper-left side of motherboard
      - description: sys_therm3, AMUX_THM2, around rhs Type-C charging controller
      - description: sys_therm4, AMUX_THM3, around SSD connector
      - description: sys_therm5, AMUX_THM4, around battery charging circuit
      - description: sys_therm6, AMUX_THM5, around keyboard

  io-channel-names:
    items:
      - const: sys_therm0
      - const: sys_therm1
      - const: sys_therm2
      - const: sys_therm3
      - const: sys_therm4
      - const: sys_therm5
      - const: sys_therm6

  wakeup-source: true

required:
  - compatible
  - reg
  - interrupts
  - io-channels
  - io-channel-names

additionalProperties: false

examples:
  - |+
    #include <dt-bindings/interrupt-controller/irq.h>
    #include <dt-bindings/iio/qcom,spmi-adc7-pm8350.h>
    i2c {
        #address-cells = <1>;
        #size-cells = <0>;

        embedded-controller@3b {
            compatible = "dell,xps13-9345-ec";
            reg = <0x3b>;
            interrupts-extended = <&tlmm 66 IRQ_TYPE_LEVEL_LOW>;

            io-channels = <&pmk8550_vadc PM8350_ADC7_GPIO3_100K_PU(1)>,
                          <&pmk8550_vadc PM8350_ADC7_GPIO4_100K_PU(1)>,
                          <&pmk8550_vadc PM8350_ADC7_AMUX_THM1_100K_PU(1)>,
                          <&pmk8550_vadc PM8350_ADC7_AMUX_THM2_100K_PU(1)>,
                          <&pmk8550_vadc PM8350_ADC7_AMUX_THM3_100K_PU(1)>,
                          <&pmk8550_vadc PM8350_ADC7_AMUX_THM4_100K_PU(1)>,
                          <&pmk8550_vadc PM8350_ADC7_AMUX_THM5_100K_PU(1)>;
            io-channel-names = "sys_therm0", "sys_therm1", "sys_therm2",
                               "sys_therm3", "sys_therm4", "sys_therm5",
                               "sys_therm6";

            wakeup-source;
        };
    };
...
```

## Documentation/devicetree/bindings/media/i2c/ovti,ov02c10.yaml
```yaml
# SPDX-License-Identifier: (GPL-2.0 OR BSD-2-Clause)
# Copyright (c) 2025 Linaro Ltd.
%YAML 1.2
---
$id: http://devicetree.org/schemas/media/i2c/ovti,ov02c10.yaml#
$schema: http://devicetree.org/meta-schemas/core.yaml#

title: Omnivision OV02C10 CMOS Sensor

maintainers:
  - Bryan O'Donoghue <bryan.odonoghue@linaro.org>

description: |
  The Omnivision OV02C10 is a 2 megapixel, CMOS image sensor which supports:
  - Automatic black level calibration (ABLC)
  - Programmable controls for frame rate, mirror and flip, binning, cropping
    and windowing
  - Output formats 10-bit 4C RGB RAW, 10-bit Bayer RAW
  - 2-lane MIPI D-PHY TX @ 800 Mbps per lane
  - 1-lane MIPI D-PHY TX @ 1.5 Gbps per lane
  - Dynamic defect pixel cancellation
  - Standard SCCB command interface

allOf:
  - $ref: /schemas/media/video-interface-devices.yaml#

properties:
  compatible:
    const: ovti,ov02c10

  reg:
    maxItems: 1

  clocks:
    maxItems: 1

  avdd-supply:
    description: Analogue circuit voltage supply.

  dovdd-supply:
    description: I/O circuit voltage supply.

  dvdd-supply:
    description: Digital circuit voltage supply.

  indicator-gpios:
    description: Active high GPIO connected LED camera activity indicator.

  reset-gpios:
    description: Active low GPIO connected to XSHUTDOWN pad of the sensor.

  port:
    $ref: /schemas/graph.yaml#/$defs/port-base
    additionalProperties: false

    properties:
      endpoint:
        $ref: /schemas/media/video-interfaces.yaml#
        additionalProperties: false

        properties:
          data-lanes:
            oneOf:
              - items:
                  - const: 1
              - items:
                  - const: 1
                  - const: 2
          link-frequencies: true
          remote-endpoint: true

        required:
          - data-lanes
          - link-frequencies
          - remote-endpoint

required:
  - compatible
  - reg
  - clocks
  - port

unevaluatedProperties: false

examples:
  - |
    #include <dt-bindings/gpio/gpio.h>

    i2c {
        #address-cells = <1>;
        #size-cells = <0>;

        ov02c10: camera@36 {
            compatible = "ovti,ov02c10";
            reg = <0x36>;

            indicator-gpios = <&tlmm 110 GPIO_ACTIVE_HIGH>;
            reset-gpios = <&tlmm 237 GPIO_ACTIVE_LOW>;
            pinctrl-names = "default";
            pinctrl-0 = <&cam_rgb_defaultt>;

            clocks = <&ov02c10_clk>;

            assigned-clocks = <&ov02c10_clk>;
            assigned-clock-parents = <&ov02c10_clk_parent>;
            assigned-clock-rates = <19200000>;

            avdd-supply = <&vreg_l7b_2p8>;
            dvdd-supply = <&vreg_l7b_1p8>;
            dovdd-supply = <&vreg_l3m_1p8>;

            port {
                ov02c10_ep: endpoint {
                    remote-endpoint = <&csiphy4_ep>;
                    data-lanes = <1 2>;
                    link-frequencies = /bits/ 64 <400000000>;
                };
            };
        };
    };
...
```
